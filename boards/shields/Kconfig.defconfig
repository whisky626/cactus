## boards/shields/Kconfig.defconfig
```kconfig
if SHIELD_CUCTUS34_LEFT

config ZMK_KEYBOARD_NAME
    default "CUCTUS"

config ZMK_SPLIT_BLE_ROLE_CENTRAL
    default y

endif

if SHIELD_CUCTUS34_LEFT || SHIELD_CUCTUS34_RIGHT

config ZMK_SPLIT
    default y

endif
```

## boards/shields/Kconfig.shield
```kconfig
# Copyright (c) 2021 The ZMK Contributors
# SPDX-License-Identifier: MIT

config SHIELD_CUCTUS34_LEFT
    def_bool $(shields_list_contains,cuctus34_left)

config SHIELD_CUCTUS34_RIGHT
    def_bool $(shields_list_contains,cuctus34_right)
```
